## Config.in
```kconfig
source "$BR2_EXTERNAL_MSD_PATH/package/m5stack-cardputerzero/Config.in"
source "$BR2_EXTERNAL_MSD_PATH/package/msd-syncfs/Config.in"
source "$BR2_EXTERNAL_MSD_PATH/package/msd-console/Config.in"
```

## package/msd-console/Config.in
```kconfig
config BR2_PACKAGE_MSD_CONSOLE
	bool "msd-console"
	help
	  Write boot progress to terminals without waiting for output space.
```

## package/msd-data-unlock/Config.in
```kconfig
config BR2_PACKAGE_MSD_DATA_UNLOCK
	bool "msd-data-unlock"
	depends on BR2_PACKAGE_CRYPTSETUP
	help
	  PIN and recovery input with fixed LUKS2 keyslots using libcryptsetup.
```

## package/msd-syncfs/Config.in
```kconfig
config BR2_PACKAGE_MSD_SYNCFS
	bool "msd-syncfs"
	help
	  Synchronize one filesystem and report writeback errors.
```
